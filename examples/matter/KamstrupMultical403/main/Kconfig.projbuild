## examples/matter/KamstrupMultical403/main/Kconfig.projbuild
```kconfig
menu "Kamstrup MULTICAL 403 example"

    config MBUS_SIMULATE_METER
        bool "Simulate the M-Bus meter in software (no wiring needed)"
        default n
        help
            Skip the real M-Bus UART exchange entirely and synthesize a
            MULTICAL 403-style telegram in software instead, using the same
            slowly-varying flow/temperature model as
            tools/kamstrup-403-sim (sines for flow, dT and return
            temperature; power, energy and volume derived from them).

            Useful for bench-testing Matter commissioning and the heat-meter
            data model on a board with no M-Bus wiring at all -- a bare dev
            board, or the custom PCB before the analogue M-Bus circuit has
            been brought up. mbus_uart_init() becomes a no-op and
            MBUS_MODE_NKE_ONLY is not meaningful with this enabled, since
            there is no link layer to reset.

endmenu
```

## firmware/sdkconfig.defaults
```kconfig
CONFIG_ESPTOOLPY_FLASHSIZE_4MB=y

#enable BT
CONFIG_BT_ENABLED=y
CONFIG_BT_NIMBLE_ENABLED=y

#disable BT connection reattempt
CONFIG_BT_NIMBLE_ENABLE_CONN_REATTEMPT=n

# Use a custom partition table
CONFIG_PARTITION_TABLE_CUSTOM=y
CONFIG_PARTITION_TABLE_FILENAME="partitions.csv"
CONFIG_PARTITION_TABLE_OFFSET=0xC000

#enable lwIP route hooks
CONFIG_LWIP_HOOK_IP6_ROUTE_DEFAULT=y
CONFIG_LWIP_HOOK_ND6_GET_GW_DEFAULT=y

# Button
CONFIG_BUTTON_PERIOD_TIME_MS=20
CONFIG_BUTTON_LONG_PRESS_TIME_MS=5000

# disable softap by default
CONFIG_ESP_WIFI_SOFTAP_SUPPORT=n
CONFIG_ENABLE_WIFI_AP=n

# Enable HKDF in mbedtls
CONFIG_MBEDTLS_HKDF_C=y

# Use compact attribute storage mode
CONFIG_ESP_MATTER_NVS_USE_COMPACT_ATTR_STORAGE=y

# Root node + flow sensor endpoint + custom heat-meter endpoint
CONFIG_ESP_MATTER_MAX_DYNAMIC_ENDPOINT_COUNT=4

# Enable OTA Requestor
CONFIG_ENABLE_OTA_REQUESTOR=y
```
